## package/x11r7/xorgproto/Config.in
```kconfig
config BR2_PACKAGE_XORGPROTO
	bool "xorgproto"
	default y 
	help
	  This package combines the protocol headers, which were
	  formerly scattered in individual packages.
```
